## kernel/Kconfig
```kconfig
#
# Xaptum Router Card driver
#

config XAPRC
       tristate "Xaptum ENF Router Card"
       depends on USB_SUPPORT
       ---help---

         Say Y here if you want to suppor the Xaptum ENF Router Card
         modules (XAP-RC-00x, XAP-RW-00x, etc.). The router cards
         expose a virtual network interface called enf0 that securely
         routes all network traffic via the Xaptum Edge Network
         Fabric, a secure IPv6 overlay network for Internet of Things
         devices.

         To compile this driver as a module, choose M here. The module
         will be called xaprc.

         If unsure, say M.
```
